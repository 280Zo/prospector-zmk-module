## Kconfig
```kconfig
config PROSPECTOR_POWER_STATUS
    bool "Report per-half USB power to Prospector"
    depends on ZMK_SPLIT && ZMK_BLE && SOC_NRF52840
    depends on !ZMK_SPLIT_ROLE_CENTRAL || SHIELD_PROSPECTOR_ADAPTER
    default n
    help
      Separate encrypted power-status telemetry. Reports VBUS presence, not
      actual charging or state of charge; leaves standard battery service intact.

config PROSPECTOR_SPLIT_SIDE
    int "Which half this peripheral is (0 unknown, 1 left, 2 right)"
    depends on PROSPECTOR_POWER_STATUS && !ZMK_SPLIT_ROLE_CENTRAL
    range 0 2
    default 0
    help
      Reported to the Prospector dongle so it places each half by side rather
      than by pairing order. Set in each half's shield .conf.

choice PROSPECTOR_STATUS_SCREEN_LAYOUT
    prompt "Status screen layout"
    default PROSPECTOR_STATUS_SCREEN_CLASSIC

config PROSPECTOR_STATUS_SCREEN_CLASSIC
    bool "Classic layout"
    help
        Standard Prospector status screen

config PROSPECTOR_STATUS_SCREEN_RADII
    bool "Radii layout"
    help
        Colorful grid layout with rounded widgets

config PROSPECTOR_STATUS_SCREEN_FIELD
    bool "Field layout"
    help
        Minimal layout with flowing typing activity visualization

config PROSPECTOR_STATUS_SCREEN_OPERATOR
    bool "Operator layout"
    help
        Technical and information dense layout

endchoice

choice PROSPECTOR_OPERATOR_THEME
    prompt "Operator colour theme at startup"
    depends on PROSPECTOR_STATUS_SCREEN_OPERATOR
    default PROSPECTOR_OPERATOR_THEME_DEFAULT
    help
      Colours of the Operator status screen when the dongle starts. The theme keys cycle
      through all themes while it runs. Diagnostics and the avatar page keep their own
      colours.

config PROSPECTOR_OPERATOR_THEME_DEFAULT
    bool "Default"

config PROSPECTOR_OPERATOR_THEME_EMBER
    bool "Ember"

config PROSPECTOR_OPERATOR_THEME_GLACIER
    bool "Glacier"

config PROSPECTOR_OPERATOR_THEME_SYNTHWAVE
    bool "Synthwave"

config PROSPECTOR_OPERATOR_THEME_SEA_SHELLS
    bool "Sea Shells"

config PROSPECTOR_OPERATOR_THEME_GITHUB
    bool "GitHub"
    help
      GitHub Dark High Contrast palette.

config PROSPECTOR_OPERATOR_THEME_CUSTOM
    bool "Custom"
    depends on PROSPECTOR_OPERATOR_CUSTOM_THEME

endchoice

config PROSPECTOR_OPERATOR_CUSTOM_THEME
    bool "Legacy single Custom Operator theme"
    depends on PROSPECTOR_STATUS_SCREEN_OPERATOR
    help
      Legacy compatibility for manually filled 14-colour configurations. Every
      colour must be set or the build stops. New named themes are created with
      the firmware repository's scripts/theme-tweak.py instead. Do not combine
      this option with a generated registry. Dark backgrounds only.

if PROSPECTOR_OPERATOR_CUSTOM_THEME

config PROSPECTOR_OPERATOR_CUSTOM_BG
    hex "Background"
    help
      Screen background, boxes behind the WPM number and layer name, and dark text on
      light fills. Must be dark; 0x000000 recommended (tinted backgrounds look washed
      out on this screen).

config PROSPECTOR_OPERATOR_CUSTOM_TEXT
    hex "Text"
    help
      Layer name, active layer dot and light number text.

config PROSPECTOR_OPERATOR_CUSTOM_MUTED
    hex "Muted text"
    help
      TOP WPM and KEY PRESS labels, balance centre tick, modifier separators; base for
      inactive modifiers and layer dots.

config PROSPECTOR_OPERATOR_CUSTOM_OUTLINE
    hex "Outline"
    help
      Balance bar track.

config PROSPECTOR_OPERATOR_CUSTOM_ACCENT
    hex "Accent"
    help
      WPM bars and the live WPM number.

config PROSPECTOR_OPERATOR_CUSTOM_INFO
    hex "Info"
    help
      TOP WPM and KEY PRESS values, held modifiers.

config PROSPECTOR_OPERATOR_CUSTOM_MARKER
    hex "Balance marker"
    help
      Balance bar marker.

config PROSPECTOR_OPERATOR_CUSTOM_CAPS
    hex "Caps"
    help
      CAPS WORD and CAPS LOCK when on.

config PROSPECTOR_OPERATOR_CUSTOM_BRIGHT
    hex "Brightness"
    help
      Brightness level shown in the modifier row.

config PROSPECTOR_OPERATOR_CUSTOM_BATTERY
    hex "Battery"
    help
      Battery ring and number box.

config PROSPECTOR_OPERATOR_CUSTOM_LOW
    hex "Low battery"
    help
      Battery ring and number box when low.

config PROSPECTOR_OPERATOR_CUSTOM_USB
    hex "USB"
    help
      USB button: active fill, inactive outline.

config PROSPECTOR_OPERATOR_CUSTOM_BLE
    hex "BLE"
    help
      BLE button: active fill, inactive outline.

config PROSPECTOR_OPERATOR_CUSTOM_SLOT
    hex "Profile slot"
    help
      Active profile slot fill; inactive slots are a dim shade of it.

endif

choice PROSPECTOR_OPERATOR_TEXTURE
    prompt "Operator background texture"
    depends on PROSPECTOR_STATUS_SCREEN_OPERATOR
    default PROSPECTOR_OPERATOR_TEXTURE_NONE
    help
      Subtle pattern behind the Operator status screen, in the theme's colours.

config PROSPECTOR_OPERATOR_TEXTURE_NONE
    bool "None"

config PROSPECTOR_OPERATOR_TEXTURE_DOTS
    bool "Dot grid (8 px)"

config PROSPECTOR_OPERATOR_TEXTURE_FINE_GRID
    bool "Fine grid (6 px)"

config PROSPECTOR_OPERATOR_TEXTURE_HATCH
    bool "Diagonal hatch"

endchoice

config PROSPECTOR_ROTATE_DISPLAY_180
    bool "Rotate the display 180 degrees"
    default n

config PROSPECTOR_ENABLE_DIAGNOSTICS_PAGE
    bool "Enable Prospector diagnostics display page"
    default n
    help
      Enable the swipe/key-selectable diagnostics display page.

config PROSPECTOR_ENABLE_AVATAR_PAGE
    bool "Enable Keyboard Knight avatar display page"
    default n
    help
      Enable the swipe/key-selectable Keyboard Knight avatar page.

config PROSPECTOR_AVATAR_SHOW_KEYBOARD_KNIGHT
    bool "Show Keyboard Knight avatar art"
    default y
    depends on PROSPECTOR_ENABLE_AVATAR_PAGE
    help
      Show the Keyboard Knight on the avatar page. Disable this to keep the
      avatar page and extras available without linking the Keyboard Knight art.

config PROSPECTOR_AVATAR_USE_PIXEL_ART
    bool "Use generated indexed pixel art for the avatar page"
    default y
    depends on PROSPECTOR_AVATAR_SHOW_KEYBOARD_KNIGHT
    help
      When enabled, the avatar page draws generated WASD knight pixel art
      from a compact 4-bit indexed asset through a custom LVGL draw
      callback. When disabled, the page uses a lightweight primitive fallback.

config PROSPECTOR_ENABLE_HIDDEN_EXTRA
    bool "Enable hidden extra"
    default n
    depends on PROSPECTOR_ENABLE_AVATAR_PAGE

config PROSPECTOR_SHOW_MODIFIERS
    bool "Display modifier key indicators (Cmd, Opt, Ctrl, Shift)"
    default y

config PROSPECTOR_SHOW_INACTIVE_MODIFIERS
    bool "Show inactive modifier indicators (dim when not pressed)"
    default y
    depends on PROSPECTOR_SHOW_MODIFIERS
    help
      When enabled, inactive modifiers are shown with a dim color.
      When disabled, inactive modifiers are hidden completely.
       Only affects classic and field layouts.

config PROSPECTOR_MODIFIER_TOAST
    bool "Show live modifier chords and Caps modes in the global toast"
    depends on SHIELD_PROSPECTOR_ADAPTER && PROSPECTOR_SHOW_MODIFIERS
    default y if PROSPECTOR_STATUS_SCREEN_OPERATOR
    select ZMK_HID_INDICATORS
    help
      Replace the Operator modifier row with a global live chord toast and
      persistent Caps Word/Caps Lock badges. Caps Lock follows host LED reports.

config PROSPECTOR_MODIFIER_ORDER
    string "Modifier display order"
    default "GACS"
    depends on PROSPECTOR_SHOW_MODIFIERS
    help
      Order of modifier indicators. Use exactly 4 characters:
      G=GUI/Cmd, A=Alt/Opt, C=Control, S=Shift.
      Each character must appear exactly once.

config PROSPECTOR_BALL_CPI
    int "Split trackball sensor CPI for the Diagnostics distance (BALL)"
    depends on PROSPECTOR_ENABLE_DIAGNOSTICS_PAGE
    default 800
    range 100 20000
    help
      Counts per inch reported by the peripheral pointing sensor before any input
      processors. Used only to convert raw travel into metres on the Diagnostics page.

config PROSPECTOR_OPERATOR_SESSION_STATS
    bool "Operator session statistics and below-layer modifier row"
    depends on PROSPECTOR_STATUS_SCREEN_OPERATOR && PROSPECTOR_MODIFIER_TOAST
    select ZMK_WPM
    select LV_FONT_MONTSERRAT_10
    select LV_FONT_MONTSERRAT_14
    help
      Show boot-best WPM, compact key count and per-side press percentages above
      the current WPM meter. Place persistent modifiers and one Caps mode slot
      below the layer line; Caps Lock takes precedence over Caps Word.

choice PROSPECTOR_MODIFIER_OS
    prompt "Modifier key style"
    default PROSPECTOR_MODIFIER_OS_MAC
    depends on PROSPECTOR_SHOW_MODIFIERS

config PROSPECTOR_MODIFIER_OS_GENERIC
    bool "Generic (CTRL, ALT, GUI, SHFT)"

config PROSPECTOR_MODIFIER_OS_WINDOWS
    bool "Windows"

config PROSPECTOR_MODIFIER_OS_MAC
    bool "Mac"

endchoice

config PROSPECTOR_USE_AMBIENT_LIGHT_SENSOR
    bool "Use ambient light sensor for auto brightness"
    default y

rsource "drivers/sensor/apds9960/Kconfig"

config PROSPECTOR_FIXED_BRIGHTNESS
    int "Fixed display brightness"
    default 50
    range 1 100
    depends on !PROSPECTOR_USE_AMBIENT_LIGHT_SENSOR

config PROSPECTOR_BRIGHTNESS_STEP
    int "Display brightness step"
    default 10
    range 1 100
    help
      Percentage-point step used by Prospector display brightness key bindings.

config PROSPECTOR_LAYER_NAME_UPPERCASE
    bool "Display layer names in uppercase"
    default y
    help
      When enabled, layer names will be converted to uppercase for display.
```

## dts/bindings/behaviors/zmk,behavior-prospector-theme.yaml
```yaml
# SPDX-License-Identifier: MIT

description: Prospector Operator theme switching behavior

compatible: "zmk,behavior-prospector-theme"

include: one_param.yaml
```

## dts/bindings/behaviors/zmk,behavior-prospector-top-reset.yaml
```yaml
# SPDX-License-Identifier: MIT

description: Reset the Prospector Operator TOP WPM record

compatible: "zmk,behavior-prospector-top-reset"

include: zero_param.yaml
```
