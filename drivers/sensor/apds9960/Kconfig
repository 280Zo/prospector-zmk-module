## drivers/sensor/apds9960/Kconfig
```kconfig
# SPDX-License-Identifier: MIT

config PROSPECTOR_APDS9960
    bool "Prospector APDS9960 ALS sensor"
    depends on DT_HAS_AVAGO_APDS9960_ENABLED
    depends on !APDS9960
    select GPIO
    select I2C
    select SENSOR
    help
      Enable Prospector's ALS-only APDS9960 driver. This driver binds to
      avago,apds9960 devicetree nodes and provides SENSOR_CHAN_LIGHT through
      Zephyr's sensor API without enabling proximity or the proximity LED.
```

## dts/bindings/behaviors/zmk,behavior-prospector-brightness.yaml
```yaml
# SPDX-License-Identifier: MIT

description: Prospector display brightness behavior

compatible: "zmk,behavior-prospector-brightness"

include: two_param.yaml
```

## dts/bindings/behaviors/zmk,behavior-prospector-display-page.yaml
```yaml
# SPDX-License-Identifier: MIT

description: Prospector display page switching behavior

compatible: "zmk,behavior-prospector-display-page"

include: one_param.yaml
```
